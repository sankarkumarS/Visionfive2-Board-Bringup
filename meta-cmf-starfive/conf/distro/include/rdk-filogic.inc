## meta-cmf-starfive/conf/distro/include/rdk-filogic.inc
```bitbake
#DISTRO_FEATURES_append = " rdk-oss-ssa"
#DISTRO_FEATURES_remove_dunfell = "telemetry2_0"

# RDKBDEV-73 : Dynamic DNS : Standardization based on broadband-forum.
#DISTRO_FEATURES_append = " ddns_broadband"

# RDKBDEV-83 : Device Gateway Association using Managed Device
#DISTRO_FEATURES_append = " device_gateway_association"

# RDKBDEV-50: Adding DSLite Functionality and related TR-181 DataModel Parameters
#DISTRO_FEATURES_append = " dslite"

# REFPLTV-1137: DLNA support for xupnp
#DISTRO_FEATURES_append = " dlna"

#DISTRO_FEATURES_append = " webconfig_bin"

# RDKB-44824: CoreNetLib move bb file location
DISTRO_FEATURES_append = " core-net-lib"

# RDKB-48800: Install DHCP Manager service file
#DISTRO_FEATURES_append_broadband = " dhcp_manager"

# Fix MeshAgent build errors
#DISTRO_FEATURES_append_broadband = " WanFailOverSupportEnable"

DISTRO_FEATURES_append_kirkstone = " kirkstone"
DISTRO_FEATURES_NATIVE_append_kirkstone = " kirkstone"

#DISTRO_FEATURES_append = " meshwifi"
#DISTRO_FEATURES_append = " ipv6"
#DISTRO_FEATURES_append = " rdkb_wan_manager"
##DISTRO_FEATURES_append = " filogic"
##DISTRO_FEATURES_append = " easymesh-controller"
##DISTRO_FEATURES_append = " emmc"
##DISTRO_FEATURES_append = " samba"
HOSTTOOLS += " python"
```

## meta-cmf-starfive/conf/distro/include/whitelist_kirkstone.inc
```bitbake
INCOMPATIBLE_LICENSE_EXCEPTIONS += "binutils:GPL-3.0-only libbfd:GPL-3.0-only libopcodes:GPL-3.0-only"
```

## meta-cmf-starfive/conf/layer.conf
```bitbake
# We have a conf and classes directory, add to BBPATH
BBPATH .= ":${LAYERDIR}"
#BBLAYERS += "${LAYERDIR}"
# We have recipes-* directories, add to BBFILES
BBFILES += "\
            ${LAYERDIR}/meta*/recipes-*/*/*.bb \
            ${LAYERDIR}/meta*/recipes-*/*/*.bbappend \
            ${LAYERDIR}/recipes-*/*/*.bb \
            ${LAYERDIR}/recipes-*/*/*.bbappend \
           "

BBFILE_COLLECTIONS += "cmf-starfive"
BBFILE_PATTERN_cmf-starfive = "^${LAYERDIR}/"
BBFILE_PRIORITY_cmf-starfive = "24"

LAYERDEPENDS_cmf-starfive = "core"
LAYERSERIES_COMPAT_cmf-starfive = "kirkstone"
#LAYERDEPENDS_cmf-starfive_append = " visionfive2"

LAYER_COMPATIBLE_MACHINE = "starfive-visionfive2"

#LAYERMACHINES = "starfive-visionfive2-rdk-broadband starfive-visionfive2"

#LAYERMACHINES = "starfive-visionfive2"

#LAYERDEPENDS_cmf-starfive = "${@' cmf-broadband rdk-wan' if ("broadband" in d.getVar('MACHINEOVERRIDES', True) or "extender" in d.getVar('MACHINEOVERRIDES', True)) else 'cmf cmf-video'}"

LAYERDEPENDS_cmf-starfive_append = " meta-starfive"
#require conf/distro/include/rdk-filogic.inc
LAYERSERIES_COMPAT_opensync = "dunfell kirkstone"
#
require conf/distro/include/rdk-rpi.inc
#require conf/include/rdk-external-src-platform.inc

include include/rdk-bbmasks-rdkb-platform.inc
_RDK_FLAVOR = "rdkb"
```

## meta-cmf-starfive/conf/machine/VF2-test.conf
```bitbake
#@TYPE: Machine
#@NAME: vf2-rdk-broadband
#@NEEDED_BSPLAYERS: meta-cmf-visionfive2
#@DESCRIPTION: Machine configuration for running a RDK broadband on Raspberry Pi 4
#@RDK_FLAVOR: rdkb

include conf/machine/starfive-visionfive2-jh7110.conf

MACHINEOVERRIDES .= ":starfive-visionfive2-jh7110:starfive-visionfive2-jh7110:broadband"

# required for image creation
MACHINE_IMAGE_NAME = "rdkb-generic-broadband-image"

#SERIAL_CONSOLE = "115200 ttyAMA0"

#MACHINE_EXTRA_RRECOMMENDS += "kernel-module-8192eu kernel-module-rtl8812au kernel-module-88x2bu"
```

## meta-cmf-starfive/conf/machine/starfive-visionfive2-jh7110-rdk-broadband.conf
```bitbake
#@TYPE: Machine
#@NAME: starfive-visionfive2-jh7110-rdk-broadband 
#@NEEDED_BSPLAYERS: meta-cmf-visionfive2
#@DESCRIPTION: Machine configuration for running a RDK broadband on RISC-V in 64 bits
#@RDK_FLAVOR: rdkb
#@arch: 64

#require conf/machine/starfive-visionfive2-jh7110.conf
include conf/machine/starfive-visionfive2-jh7110.conf

MACHINEOVERRIDES .= ":starfive-visionfive2-jh7110"
#MACHINEOVERRIDES .= ":broadband:visionfive"
MACHINE_EXTRA_RRECOMMENDS += "kernel-modules"

#MACHINE_IMAGE_NAME = "rdkb-generic-broadband-image"
# required for image creation

#COMPATIBLE_MACHINE = "(starfive-visionfive2-jh7110)"
#SERIAL_CONSOLE = "115200 ttyAMA0"
PREFERRED_PROVIDER_virtual/kernel = "linux-starfive-visionfive"
PREFERRED_PROVIDER_virtual/bootloader = "u-boot-visionfive"
PREFERRED_VERSION_linux-visionfive2 = "5.15.%"
#MACHINE_EXTRA_RRECOMMENDS += "kernel-module-8192eu kernel-module-rtl8812au kernel-module-88x2bu"

#PREFERRED_VERSION_linux-raspberrypi_dunfell = "5.10.%"
#PREFERRED_VERSION_linux-libc-headers_dunfell = "5.10.%"
```

## meta-cmf-starfive/conf/machine/starfive-visionfive2-rdk-broadband.conf
```bitbake
#@TYPE: Machine
#@NAME: starfive-visionfive2-rdk-broadband 
#@NEEDED_BSPLAYERS: meta-cmf-starfive
#@DESCRIPTION: Machine configuration for running a RDK broadband on RISC-V in 64 bits
#@RDK_FLAVOR: rdkb
#@arch: 64

include conf/machine/starfive-visionfive2.conf
#include conf/machine/starfive-visionfive2-jh7110.conf
# Machine configuration for VisionFive 2 (StarFive JH7110 SoC)
#TARGET_ARCH = "riscv64"
#MACHINE = "starfive-visionfive2-rdk"
#COMPATIBLE_MACHINE = "starfive-visionfive2"

#MACHINE = "rdkb-generic-broadband-image"
#PREFERRED_PROVIDER_virtual/kernel = "linux-starfive-dev"

PREFERRED_PROVIDER_virtual/kernel = "linux-starfive-dev"
PREFERRED_VERSION_linux-starfive-dev = "5.15%"
KERNEL_IMAGETYPE = "fitImage"

#PREFERRED_PROVIDER_virtual/kernel_starfive-visionfive2 = "linux-starfive-dev"
#MACHINEOVERRIDES .= ":starfive-visionfive2:broadband"
MACHINEOVERRIDES .= ":starfive-visionfive2:starfive-visionfive2:broadband"
#MACHINEOVERRIDES .= ":raspberrypi4-64:rpi:broadband"

MACHINEOVERRIDES .= ":broadband"
# required for image creation
MACHINE_IMAGE_NAME = "rdkb-generic-broadband-image"

# required for image creation
#MACHINE_IMAGE_NAME = "rdkb-generic-broadband-image"
```

## meta-cmf-starfive/conf/machine/starfive-visionfive2.conf
```bitbake
#@TYPE: Machine
#@NAME: starfive-visionfive2-rdk-broadband 
#@NEEDED_BSPLAYERS: meta-cmf-starfive
#@DESCRIPTION: Machine configuration for running a RDK broadband on RISC-V in 64 bits
#@RDK_FLAVOR: rdkb
#@arch: 64

include conf/machine/starfive-visionfive2.conf
#include conf/machine/starfive-visionfive2-jh7110.conf
# Machine configuration for VisionFive 2 (StarFive JH7110 SoC)
#TARGET_ARCH = "riscv64"
MACHINE = "starfive-visionfive2"
#COMPATIBLE_MACHINE = "starfive-visionfive2"

#MACHINE = "rdkb-generic-broadband-image"
#MACHINE_IMAGE_NAME = "rdkb-generic-broadband-image"
#PREFERRED_PROVIDER_virtual/kernel = "linux-starfive-dev"
#PREFERRED_VERSION_linux-starfive-dev = "5.15%"
#PREFERRED_PROVIDER_virtual/kernel_starfive-visionfive2 = "linux-starfive-dev"
#PREFERRED_VERSION_linux-starfive-dev_starfive-visionfive2 = "5.15%"
KERNEL_IMAGETYPE = "fitImage"
PREFERRED_PROVIDER_virtual/kernel = "linux-starfive-dev"
PREFERRED_VERSION_linux-starfive-dev = "5.15%"

#MACHINE_EXTRA_RRECOMMENDS += "kernel-modules"

#MACHINEOVERRIDES .= ":broadband"

#MACHINEOVERRIDES .= ":broadband"
#MACHINEOVERRIDES .= ":starfive-visionfive2"

# required for image creation
MACHINE_IMAGE_NAME = "rdkb-generic-broadband-image"
```

## meta-cmf-starfive/conf/machine/tmp-visionfive2-jh7110.conf
```bitbake
#@TYPE: Machine
#@NAME: starfive-visionfive2-jh7110-rdk-broadband 
#@NEEDED_BSPLAYERS: meta-cmf-visionfive2
#@DESCRIPTION: Machine configuration for running a RDK broadband on RISC-V in 64 bits
#@RDK_FLAVOR: rdkb
#@arch: 64

include conf/machine/starfive-visionfive2-jh7110.conf

# Machine configuration for VisionFive 2 (StarFive JH7110 SoC)
TARGET_ARCH = "riscv64"
MACHINE = "visionfive2-jh7110"

# Processor and SOC specifics
CPU = "riscv64"
SOC_FAMILY = "starfive"
#MACHINE_FEATURES = "wifi bluetooth pci usb"
MACHINE_EXTRA_RRECOMMENDS += "kernel-modules"
#MACHINEOVERRIDES .= ":starfive-visionfive2-jh7110"
MACHINEOVERRIDES .= ":visionfive2-jh7110"
# Define the bootloader and U-Boot configuration
#UBOOT_MACHINE = "visionfive2_jh7110_defconfig"
PREFERRED_PROVIDER_virtual/kernel = "linux-starfive-visionfive"
#PREFERRED_PROVIDER_virtual/kernel = "linux-starfive"
PREFERRED_PROVIDER_virtual/bootloader = "u-boot-visionfive"
#PREFERRED_VERSION_linux-visionfive2 = "5.15.%"
KERNEL_DEFCONFIG = "starfive_jh7110_defconfig"
# Toolchain for cross-compiling for RISC-V
TOOLCHAIN = "riscv64-linux-gnu"
#GCC_VERSION = "11.2"
GCC_TARGET = "riscv64-linux-gnu"
CROSS_COMPILE = "riscv64-linux-gnu-"
#STAGING_DIR_TARGET = "${TOPDIR}/tmp/work/${TARGET_SYS}/sysroot"
# Configure kernel (ensure it's for RISC-V and the JH7110 SoC)
#PREFERRED_PROVIDER_virtual/kernel = "linux-starfive"
#PREFERRED_PROVIDER_u-boot = "u-boot-starfive"

# Enable 64-bit architecture support
MACHINE_CPUARCH = "riscv64"
MACHINE_FEATURES += "64bit"

# File system settings (adjust based on your requirements)
ROOTFS_POSTPROCESS_COMMAND += "do_rootfs"

IMAGE_BOOT_FILES=" Image  uEnv.txt starfive_visionfive2.dtb  "
```
